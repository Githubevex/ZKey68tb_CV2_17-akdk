## boards/shields/zkey68tb_cv2_17/Kconfig.defconfig
```kconfig
if SHIELD_ZKEY68TB_CV2_17_RIGHT

config ZMK_KEYBOARD_NAME
    default "zkey68tb_cv2_17"

# 2026/05/14追加
config ZMK_POINTING
    default y

config PAW3222
    default y
# ---

endif

if SHIELD_ZKEY68TB_CV2_17_LEFT || SHIELD_ZKEY68TB_CV2_17_RIGHT

config ZMK_SPLIT
    default y

endif
```

## boards/shields/zkey68tb_cv2_17/Kconfig.shield
```kconfig
config SHIELD_ZKEY68TB_CV2_17_LEFT
    def_bool $(shields_list_contains,zkey68tb_cv2_17_left)
config SHIELD_ZKEY68TB_CV2_17_RIGHT
    def_bool $(shields_list_contains,zkey68tb_cv2_17_right)
```

## config/west.yml
```yaml
manifest:
  remotes:
    - name: zmkfirmware
      url-base: https://github.com/zmkfirmware
    - name: sekigon-gonnoc
      url-base: https://github.com/sekigon-gonnoc
    - name: prospector
      url-base: https://github.com/t-ogura
  projects:
    - name: zmk
      remote: zmkfirmware
      revision: v0.3
      import: app/west.yml
    - name: zmk-driver-paw3222
      remote: sekigon-gonnoc
      revision: main
    - name: prospector-zmk-module
      remote: prospector
      revision: v2.1.0
      path: modules/prospector-zmk-module
  self:
    path: config
```
